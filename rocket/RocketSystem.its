## rocket/RocketSystem.its
```
/dts-v1/;

/ {
    binman: binman {
        multiple-images;
    };
};

&binman {
    itb {
        filename = "u-boot.itb";

        fit {
            description = "Configuration to load OpenSBI before U-Boot";
            #address-cells = <2>;
            fit,fdt-list = "of-list";

            images {
                uboot {
                    description = "U-Boot";
                    type = "standalone";
                    os = "U-Boot";
                    arch = "riscv";
                    compression = "none";
                    load = <0x0 0x81200000>;
                    entry = <0x0 0x81200000>;
                    uboot_blob: blob-ext {
                        filename = "u-boot-nodtb.bin";
                    };
                };

                opensbi {
                    description = "OpenSBI fw_dynamic Firmware";
                    type = "firmware";
                    os = "opensbi";
                    arch = "riscv";
                    compression = "none";
                    load = <0x0 0x80000000>;
                    entry = <0x0 0x80000000>;
                    opensbi_blob: opensbi {
                        filename = "fw_dynamic.bin";
                        missing-msg = "opensbi";
                    };
                };

                fdt-1 {
                    description = "Flattned Device Tree";
                    type = "flat_dt";
                    compression = "none";
                    load = <0x0 0x85100000>;
                    fdt_blob: blob-ext {
                        filename = "fdt-1.dtb";
                    };
                };
            };

            configurations {
                default = "conf-1";
                conf-1 {
                    description = "Boot with OpenSBI and U-Boot";
                    loadables = "uboot";
                    firmware = "opensbi";
                    fdt = "fdt-1";
                };
            };
        };
    };
};
```

## tftpboot/kernel.its
```
/dts-v1/;

/ {
    description = "Boot Linux Kernel";
    images {
        kernel-1 {
            description = "Kernel-1";
            data = /incbin/("./Image");
            type = "kernel";
            arch = "riscv";
            os = "linux";
            load = <0x94100000>;
            entry = <0x94100000>;
            compression = "none";
        };
        ramdisk-1 {
            description = "Ramdisk-1";
            data = /incbin/("./initramfs.cpio.gz");
            type = "ramdisk";
            arch = "riscv";
            os = "linux";
            load = <0x96000000>;
            entry = <0x96000000>;
            compression = "none";
        };
        fdt-1 {
            description = "FDT-1";
            data = /incbin/("./fdt-1.dtb");
            type = "flat_dt";
            arch = "riscv";
            compression = "none";
            load = <0x94000000>;
        };
    };
    configurations {                                                                                                        
        default = "config-1";                                                                                               
        config-1 {                                                                                                          
             description = "Linux Config-1 (Default)";
             kernel = "kernel-1";                                                                                            
             ramdisk = "ramdisk-1";                                                                                          
             fdt = "fdt-1";                                                                                                  
        };
    };   
};
```
